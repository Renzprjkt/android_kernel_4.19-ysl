## drivers/input/touchscreen/Kconfig
```kconfig
#
# Touchscreen driver configuration
#
menuconfig INPUT_TOUCHSCREEN
	bool "Touchscreens"
	help
	  Say Y here, and a list of supported touchscreens will be displayed.
	  This option doesn't affect the kernel.

	  If unsure, say Y.

if INPUT_TOUCHSCREEN

config TOUCHSCREEN_PROPERTIES
	def_tristate INPUT
	depends on INPUT

config TOUCHSCREEN_GOODIX
	tristate "Goodix I2C touchscreen"
	depends on I2C
	depends on GPIOLIB || COMPILE_TEST
	help
	  Say Y here if you have the Goodix touchscreen (such as one
	  installed in Onda v975w tablets) connected to your
	  system. It also supports 5-finger chip models, which can be
	  found on ARM tablets, like Wexler TAB7200 and MSI Primo73.

	  If unsure, say N.

	  To compile this driver as a module, choose M here: the
	  module will be called goodix.

config TOUCHSCREEN_SYNAPTICS_DSX
        bool "Synaptics Touchscreen Driver"
        depends on I2C
        help
          Say Y here if you have a Synaptics Touchscreen.

          If unsure, say N.

source "drivers/input/touchscreen/synaptics_dsx/Kconfig"
source "drivers/input/touchscreen/focaltech_touch/Kconfig"

config TOUCHSCREEN_FT5X06
       tristate "FocalTech touchscreens"
       depends on I2C
       help
         Say Y here if you have a ft5X06 touchscreen.
	 Ft5x06 controllers are multi touch controllers which can
	 report 5 touches at a time.

         If unsure, say N.

         To compile this driver as a module, choose M here: the
         module will be called ft5x06_ts.

config TOUCHSCREEN_GEN_VKEYS
	tristate "Touchscreen Virtual Keys Driver"
	help
         Say Y here if you want to generate a sysfs entry for virtual
	 keys on Android.

	 If unsure, say N.

	 To compile this driver as a module, choose M here: the
	 module will be called gen_vkeys.

config FT_SECURE_TOUCH
	bool "Secure Touch support for Focaltech Touchscreen"
	depends on TOUCHSCREEN_FT5X06
	help
	  Say Y here
	  -Focaltech touch driver is connected
	  -To enable secure touch for Focaltech touch driver

	  If unsure, say N.

config TOUCHSCREEN_GT917D
       tristate "Goodix touchscreens"
       depends on I2C
       help
         Say Y here if you have a GT917D touchscreen.
         GT917D controllers are multi touch controllers which can
         report 10 touches at a time.

         If unsure, say N.

         To compile this driver as a module, choose M here: the
         module will be called GT9xx.

source "drivers/input/touchscreen/gt917d/Kconfig"

config VITURALSAR
	bool "Vitural Sar series"
	depends on I2C
	help
	  Say Y here if you have a Goodix GT9xx touchscreen.
	  Gt9xx controllers are multi touch controllers which can
	  report 5 touches at a time.

          If unsure, say N.

endif
```
